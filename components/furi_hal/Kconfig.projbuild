## components/furi_hal/Kconfig.projbuild
```kconfig
menu "External UART header"
    config T_EMBED_EXTERNAL_UART
        bool "Reserve T-Embed GPIO43/44 for external UART"
        depends on IDF_TARGET_ESP32S3
        default n
        help
            Reserve the UART header for GPS or a UART BW16 module.
            BW16 on I2C can coexist with GPS on this separate UART header.
            Park GPIO43/44 as pulled-up inputs at boot instead of NRF outputs.
            Use only when the NRF is electrically absent from these pins.
            Select the USB Serial/JTAG console to keep logs off UART TX43.
endmenu

menu "T-Embed BW16 I2C"
    config T_EMBED_BW16_I2C
        bool "Enable BW16 on the shared GPIO8/18 I2C bus"
        depends on IDF_TARGET_ESP32S3
        default n
        help
            Enable the BW16 I2C firmware at address 0x42 using the existing
            100 kHz power/NFC bus. Does not use or reconfigure GPIO43/44.
            Non-NRF boards may also reserve UART43/44 for GPS. On CC1101
            Plus, keep external UART disabled because NRF owns CE43/CSN44.
endmenu

menu "T-Embed Plus SD recovery"
    config T_EMBED_PLUS_SD_RECOVERY
        bool "Enable Plus shared-SPI startup and SD recovery"
        depends on IDF_TARGET_ESP32S3 && T_EMBED_BW16_I2C && !T_EMBED_EXTERNAL_UART
        default n
        help
            Opt-in for the separate T-Embed CC1101 Plus recovery build.
            Initialize the SD card before display/radio SPI traffic, cleanly
            retry failed SD initialization and recover failed startup mounts.
            Does not switch power rails or disable brownout protection.
endmenu

menu "Forced reboot combo"
    config FURI_HAL_REBOOT_COMBO
        bool "Forced reboot by holding two buttons (esp_timer ISR on CPU1)"
        depends on IDF_TARGET_ESP32S3 && !FREERTOS_UNICORE && ESP_TIMER_SUPPORTS_ISR_DISPATCH_METHOD
        default n
        help
            Holding both configured reboot buttons continuously for 5 s
            triggers a software reset immediately, while they are still held.
            A pair already held when the input service starts is ignored until
            both are released to prevent a reset loop. The check runs from an
            ISR-dispatched esp_timer on CPU1, so it still works when CPU0 is
            stuck. The board header names the pins
            (BOARD_REBOOT_COMBO_PIN_A/B). Enabled per board in
            sdkconfig.defaults.<board>.
endmenu

menu "qFlipper / RPC diagnostics (QFDIAG)"
    config FURI_QFDIAG
        bool "Enable QFDIAG transfer diagnostics"
        default n
        help
            Debug-only instrumentation of the qFlipper USB path:
            USB CDC -> qflipper_bridge -> RPC session/handlers -> storage ->
            FatFs diskio (SPI bus lock vs card time) -> USB TX.

            While qFlipper mode owns the USB PHY the USB-Serial-JTAG console
            is dead, so every ESP_LOG line is copied into a 256 KB PSRAM ring
            and appended to /ext/qfdiag.log (capped at 768 KB) when the host
            disconnects; download it with qFlipper. Also adds 1 s pipeline
            stats, an RX byte trace that hexdumps a failing protobuf message,
            per-message RPC trace logs, SD/SPI-lock timing and ping/write
            throughput lines.

            Logging only, no behaviour change. Costs ~266 KB PSRAM, a log
            hook on every ESP_LOG line, and a 1-2 s SD write on each
            disconnect, so keep it OFF in normal builds. Enable with
            idf.py -B build-<board> menuconfig, or add CONFIG_FURI_QFDIAG=y
            to sdkconfig.defaults.<board>, then rebuild.
endmenu
```

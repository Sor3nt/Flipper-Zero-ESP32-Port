## components/furi_hal/Kconfig.projbuild
```kconfig
menu "External UART header"
    config T_EMBED_EXTERNAL_UART
        bool "Reserve T-Embed GPIO43/44 for external UART"
        depends on IDF_TARGET_ESP32S3
        default n
        help
            Reserve the UART header for GPS or a UART BW16 module.
            BW16 on I2C can coexist with GPS on this separate UART header.
            Park GPIO43/44 as pulled-up inputs at boot instead of NRF outputs.
            Use only when the NRF is electrically absent from these pins.
            Select the USB Serial/JTAG console to keep logs off UART TX43.
endmenu

menu "T-Embed BW16 I2C"
    config T_EMBED_BW16_I2C
        bool "Enable BW16 on the shared GPIO8/18 I2C bus"
        depends on IDF_TARGET_ESP32S3
        default n
        help
            Enable the BW16 I2C firmware at address 0x42 using the existing
            100 kHz power/NFC bus. Does not use or reconfigure GPIO43/44.
            Non-NRF boards may also reserve UART43/44 for GPS. On CC1101
            Plus, keep external UART disabled because NRF owns CE43/CSN44.
endmenu

menu "T-Embed Plus SD recovery"
    config T_EMBED_PLUS_SD_RECOVERY
        bool "Enable Plus shared-SPI startup and SD recovery"
        depends on IDF_TARGET_ESP32S3 && T_EMBED_BW16_I2C && !T_EMBED_EXTERNAL_UART
        default n
        help
            Opt-in for the separate T-Embed CC1101 Plus recovery build.
            Initialize the SD card before display/radio SPI traffic, cleanly
            retry failed SD initialization and recover failed startup mounts.
            Does not switch power rails or disable brownout protection.
endmenu
```

## sdkconfig.defaults.m5stick_s3
```kconfig
# =============================================================================
# M5Stack StickS3 configuration (ESP32-S3-PICO-1-N8R8: 8 MB flash + 8 MB PSRAM)
# Overrides the auto-applied sdkconfig.defaults.esp32s3 (16 MB multiboot) profile.
# =============================================================================

# Flash: 8 MB
CONFIG_ESPTOOLPY_FLASHSIZE_8MB=y
CONFIG_ESPTOOLPY_FLASHSIZE="8MB"

# Partition table: 3.5 MB app + 4.4 MB LittleFS "storage" (no SD on this board).
CONFIG_PARTITION_TABLE_CUSTOM=y
CONFIG_PARTITION_TABLE_CUSTOM_FILENAME="partitions_m5stick_s3.csv"
CONFIG_PARTITION_TABLE_FILENAME="partitions_m5stick_s3.csv"

# =============================================================================
# PSRAM — ENABLED (8 MB octal). This is the big win vs the Cardputers: malloc can
# spill to PSRAM, so BLE / WiFi / large buffers have headroom (no RAM starvation).
# =============================================================================
CONFIG_SPIRAM=y
CONFIG_SPIRAM_MODE_OCT=y
CONFIG_SPIRAM_SPEED_80M=y
CONFIG_SPIRAM_BOOT_INIT=y
CONFIG_SPIRAM_IGNORE_NOTFOUND=y
CONFIG_SPIRAM_USE_MALLOC=y
CONFIG_SPIRAM_MALLOC_ALWAYSINTERNAL=16384
CONFIG_SPIRAM_TRY_ALLOCATE_WIFI_LWIP=y

CONFIG_BOOTLOADER_VDDSDIO_BOOST_3_3V=y

# =============================================================================
# FreeRTOS
# =============================================================================
CONFIG_FREERTOS_UNICORE=y
CONFIG_FREERTOS_HZ=1000
CONFIG_FREERTOS_OPTIMIZED_SCHEDULER=y
CONFIG_FREERTOS_CHECK_STACKOVERFLOW_CANARY=y
CONFIG_FREERTOS_IDLE_TASK_STACKSIZE=2048

# =============================================================================
# CPU
# =============================================================================
CONFIG_ESP_DEFAULT_CPU_FREQ_MHZ_240=y
CONFIG_ESP_DEFAULT_CPU_FREQ_MHZ=240
CONFIG_ESP_MAIN_TASK_STACK_SIZE=3584
CONFIG_ESP_SYSTEM_EVENT_TASK_STACK_SIZE=2048
CONFIG_ESP_TIMER_TASK_STACK_SIZE=2048

# =============================================================================
# Heap
# =============================================================================
CONFIG_HEAP_POISONING_DISABLED=y
CONFIG_HEAP_TRACING_OFF=y
CONFIG_ESP_SYSTEM_ABORT_ON_ALLOC_FAILURE=n

# =============================================================================
# WiFi (defaults are fine with PSRAM; keep modest buffers)
# =============================================================================
CONFIG_ESP_WIFI_TASK_PINNED_TO_CORE_1=y
CONFIG_ESP_WIFI_IRAM_OPT=y
CONFIG_ESP_WIFI_RX_IRAM_OPT=y

# =============================================================================
# LWIP
# =============================================================================
CONFIG_LWIP_MAX_SOCKETS=8
CONFIG_LWIP_TCPIP_CORE_LOCKING=y

# =============================================================================
# Bluetooth — NimBLE (built-in radio; PSRAM gives it room)
# =============================================================================
CONFIG_BT_ENABLED=y
CONFIG_BT_NIMBLE_ENABLED=y
CONFIG_BT_NIMBLE_ROLE_PERIPHERAL=y
CONFIG_BT_NIMBLE_ROLE_BROADCASTER=y
CONFIG_BT_NIMBLE_ROLE_CENTRAL=y
CONFIG_BT_NIMBLE_ROLE_OBSERVER=y
CONFIG_BT_NIMBLE_MAX_CONNECTIONS=1
CONFIG_BT_NIMBLE_NVS_PERSIST=y
CONFIG_BT_NIMBLE_HOST_TASK_STACK_SIZE=4096

# =============================================================================
# Newlib / compiler
# =============================================================================
CONFIG_NEWLIB_NANO_FORMAT=y
CONFIG_COMPILER_OPTIMIZATION_SIZE=y

# =============================================================================
# RMT (Infrared)
# =============================================================================
CONFIG_RMT_ISR_IRAM_SAFE=y
CONFIG_RMT_SUPPRESS_DEPRECATE_WARN=y

# =============================================================================
# Console: native USB-Serial-JTAG
# =============================================================================
CONFIG_ESP_CONSOLE_USB_SERIAL_JTAG=y
CONFIG_LOG_DEFAULT_LEVEL_INFO=y

# =============================================================================
# TinyUSB (base firmware's USB CDC stack needs this at compile time)
# =============================================================================
CONFIG_TINYUSB_HID_COUNT=3
CONFIG_TINYUSB_DESC_BOS_ENABLED=y
CONFIG_TINYUSB_HID_BUFSIZE=64
CONFIG_TINYUSB_CDC_ENABLED=y
CONFIG_TINYUSB_CDC_COUNT=1

# =============================================================================
# Watchdog
# =============================================================================
CONFIG_ESP_TASK_WDT_EN=y
CONFIG_ESP_TASK_WDT_INIT=y
CONFIG_ESP_TASK_WDT_TIMEOUT_S=10
CONFIG_ESP_INT_WDT=y

# Panic coredump to flash (reliable backtrace)
CONFIG_ESP_COREDUMP_ENABLE_TO_FLASH=y
CONFIG_ESP_COREDUMP_DATA_FORMAT_ELF=y
CONFIG_ESP_COREDUMP_CHECKSUM_CRC32=y
```
